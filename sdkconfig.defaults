## sdkconfig.defaults
```kconfig
CONFIG_AUTOSTART_ARDUINO=y
CONFIG_TINYUSB_CDC_ENABLED=y
CONFIG_USB_HOST_HUBS_SUPPORTED=y
CONFIG_FREERTOS_HZ=1000
CONFIG_ESPTOOLPY_FLASHSIZE_16MB=y
CONFIG_FLASHMODE_QIO=y
CONFIG_ESP32S3_DEFAULT_CPU_FREQ_240=y
```
